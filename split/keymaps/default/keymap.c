// Copyright 2022 Yoichiro Tanaka (@yoichiro)
// SPDX-License-Identifier: GPL-2.0-or-later

#include QMK_KEYBOARD_H

enum my_keycodes {
    EK_LOGO = SAFE_RANGE // KEYCODE для показа логотипа на дисплее
};

enum layer_number {
    _QWERTY = 0,
    _LOWER,
    _RAISE,
    _ADJUST,
};

char* get_current_layer_name(void) {
    switch (get_highest_layer(layer_state)) {
        case _QWERTY: return "Default";
        case _LOWER: return "Lower";
        case _RAISE: return "Raise";
        case _ADJUST: return "Adjust";
        default: return "Undef";
    }
}

#define LOWER MO(_LOWER)
#define RAISE MO(_RAISE)
#define QK_BOOT QK_BOOTLOADER
const uint16_t PROGMEM keymaps[][MATRIX_ROWS][MATRIX_COLS] = {
    [_QWERTY] = LAYOUT_split_3x6_5(
    //+--------+--------+--------+--------+--------+--------+                 +--------+--------+--------+--------+--------+--------+
        KC_ESC,  KC_1,    KC_2,    KC_3,    KC_4,    KC_5,                      KC_6,    KC_7,    KC_8,    KC_9,    KC_0,    KC_MINS,
    //+--------+--------+--------+--------+--------+--------+                 +--------+--------+--------+--------+--------+--------+
        KC_TAB,  KC_Q,    KC_W,    KC_E,    KC_R,    KC_T,                      KC_Y,    KC_U,    KC_I,    KC_O,    KC_P,    KC_LBRC,
    //+--------+--------+--------+--------+--------+--------+                 +--------+--------+--------+--------+--------+--------+
        KC_LSFT, KC_A,    KC_S,    KC_D,    KC_F,    KC_G,                      KC_H,    KC_J,    KC_K,    KC_L,    KC_SCLN, KC_QUOT,
    //+--------+--------+--------+--------+--------+--------+                 +--------+--------+--------+--------+--------+--------+
        KC_LCTL, KC_Z,    KC_X,    KC_C,    KC_V,    KC_B,                      KC_N,    KC_M,    KC_COMM, KC_DOT,  KC_SLSH, KC_BSLS,
    //+--------+--------+--------+--------+--------+--------+--------+--------+--------+--------+--------+--------+--------+--------+
        LOWER,                              KC_SPC , KC_SPC,  KC_LALT, KC_RALT, KC_ENT,   KC_BSPC,                           QK_BOOT
    //+--------+--------+--------+--------+--------+--------+--------+--------+--------+--------+--------+--------+--------+--------+
    ),

    [_LOWER] = LAYOUT_split_3x6_5(
    //+--------+--------+--------+--------+--------+--------+                 +--------+--------+--------+--------+--------+--------+
        _______, _______, _______, _______, EK_LOGO, QK_BOOT,                   _______, _______, _______, _______, _______, _______,
    //+--------+--------+--------+--------+--------+--------+                 +--------+--------+--------+--------+--------+--------+
        KC_ESC,  KC_1,    KC_2,    KC_3,    KC_4,    KC_5,                      KC_6,    KC_7,    KC_8,    KC_9,    KC_0,    KC_BSPC,
    //+--------+--------+--------+--------+--------+--------+                 +--------+--------+--------+--------+--------+--------+
        KC_LCTL, _______, _______, _______, _______, _______,                   KC_LEFT, KC_DOWN, KC_UP,   KC_RIGHT,_______, _______,
    //+--------+--------+--------+--------+--------+--------+                 +--------+--------+--------+--------+--------+--------+
        KC_LSFT, _______, _______, _______, _______, _______,                   _______, _______, _______, _______, _______, _______,
    //+--------+--------+--------+--------+--------+--------+--------+--------+--------+--------+--------+--------+--------+--------+
        _______,                            KC_SPC , KC_SPC,  KC_LALT, KC_RALT, KC_ENT,   KC_BSPC,                           KC_X
    //+--------+--------+--------+--------+--------+--------+--------+--------+--------+--------+--------+--------+--------+--------+
    ),

    [_RAISE] = LAYOUT_split_3x6_5(
    //+--------+--------+--------+--------+--------+--------+                 +--------+--------+--------+--------+--------+--------+
        _______, _______, _______, _______, _______, _______,                   _______, _______, _______, _______, _______, _______,
    //+--------+--------+--------+--------+--------+--------+                 +--------+--------+--------+--------+--------+--------+
        KC_ESC,  KC_EXLM, KC_AT,   KC_HASH, KC_DLR,  KC_PERC,                   KC_CIRC, KC_AMPR, KC_ASTR, KC_LPRN, KC_RPRN, KC_BSPC,
    //+--------+--------+--------+--------+--------+--------+                 +--------+--------+--------+--------+--------+--------+
        KC_LCTL, _______, _______, _______, _______, _______,                   KC_MINS, KC_EQL,  KC_LCBR, KC_RCBR, KC_PIPE, KC_GRV,
    //+--------+--------+--------+--------+--------+--------+                 +--------+--------+--------+--------+--------+--------+
        KC_LSFT, KC_TILD, _______, _______, _______, _______,                   KC_UNDS, KC_PLUS, KC_LBRC, KC_RBRC, KC_BSLS, KC_TILD,
    //+--------+--------+--------+--------+--------+--------+--------+--------+--------+--------+--------+--------+--------+--------+
        KC_X,                               KC_SPC , KC_SPC,  KC_LALT, KC_RALT, KC_ENT,   KC_BSPC,                           KC_X
    //+--------+--------+--------+--------+--------+--------+--------+--------+--------+--------+--------+--------+--------+--------+
    ),

    [_ADJUST] = LAYOUT_split_3x6_5(
    //+--------+--------+--------+--------+--------+--------+                 +--------+--------+--------+--------+--------+--------+
        _______, _______, _______, _______, _______, _______,                   _______, _______, _______, _______, _______, _______,
    //+--------+--------+--------+--------+--------+--------+                 +--------+--------+--------+--------+--------+--------+
        QK_BOOT, _______, _______, _______, _______, _______,                   KC_F1,   KC_F2,   KC_F3,   KC_F4,   KC_F5,   KC_F6,
    //+--------+--------+--------+--------+--------+--------+                 +--------+--------+--------+--------+--------+--------+
        UG_TOGG, UG_HUEU, UG_SATU, UG_VALU, _______, _______,                   KC_F7,   KC_F8,   KC_F9,   KC_F10,  KC_F11,  KC_F12,
    //+--------+--------+--------+--------+--------+--------+                 +--------+--------+--------+--------+--------+--------+
        UG_NEXT, UG_HUED, UG_SATD, UG_VALD, _______, _______,                   _______, _______, _______, _______, _______, _______,
    //+--------+--------+--------+--------+--------+--------+--------+--------+--------+--------+--------+--------+--------+--------+
        KC_X,                               KC_SPC , KC_SPC,  KC_LALT, KC_RALT, KC_ENT,   KC_BSPC,                           KC_X
    //+--------+--------+--------+--------+--------+--------+--------+--------+--------+--------+--------+--------+--------+--------+
    )
};

// TODO: определиться, в какой файл перенести это:
void keyboard_post_init_user(void) {
    debug_enable = true; // Если = false, всё равно выводится матрица
    debug_matrix = false; // печатать матрицу кнопок при изменении их состояния
    debug_keyboard = true; // Печатать события клавиатуры при нажатиях:
    debug_mouse = false;
}

// TODO: что это?
layer_state_t layer_state_set_user(layer_state_t state) {
    return update_tri_layer_state(state, _LOWER, _RAISE, _ADJUST);
}
void display_logo(void); // функция должна быть определена в oled.c

bool process_record_user(uint16_t keycode, keyrecord_t *record) {
    dprint("process_record_user!!!!!!!!!!!!!!!!!\n");
    switch (keycode) {
        case EK_LOGO:
            if (!record->event.pressed) {
                // при отпускании кнопки снова отобразим на дисплее логотип на определенное время
                display_logo();
            }
            return false; // Skip all further processing of this key
        default: return true; // Process all other keycodes normally
    }
}
